GPIOA_BASE  EQU 0x40010800      ; GPIOA基地址
GPIOA_CRL   EQU GPIOA_BASE      ; 低配置寄存器
GPIOA_CRH   EQU GPIOA_BASE+0x04 ; 高配置寄存器
GPIOA_IDR   EQU GPIOA_BASE+0x08 ; 输入数据寄存器
GPIOA_ODR   EQU GPIOA_BASE+0x0c ; 输出数据寄存器
GPIOA_BSRR  EQU GPIOA_BASE+0x10 ; 端口位置位/清除寄存器
GPIOA_BRR   EQU GPIOA_BASE+0x14 ; 端口位清除寄存器

CFGAL       EQU 0x33333333      ; PA0~7：  推挽输出，50MHz
CFGAH       EQU 0x00000333      ; PA8~10： 推挽输出，50MHz

GPIOB_BASE EQU 0x40010c00       ; GPIOB基地址
GPIOB_CRL  EQU GPIOB_BASE+0x00  ; GPIOB低配置寄存器
GPIOB_CRH  EQU GPIOB_BASE+0x04  ; GPIOB高配置寄存器
GPIOB_IDR  EQU GPIOB_BASE+0x08  ; GPIOB输入数据寄存器
GPIOB_ODR  EQU GPIOB_BASE+0x0c  ; GPIOB输出数据寄存器
GPIOB_BSRR EQU GPIOB_BASE+0x10  ; GPIOB位端口置位/清零寄存器
CFGBL      EQU 0x0000      		; GPIOB配置：PB0--模拟输入
	
RCC_APB2ENR EQU 0x40021018
GIOPAEN     EQU 0x00000004  	; GPIOA 使能位
GIOPBEN     EQU 0x00000008      ; GPIOB 使能位
AFIOEN      EQU 0x00000001      ; AFIO 时钟使能位
ADC1EN		EQU 0x00000200		; ADC1 使能位
APB2ENALL   EQU GIOPAEN :OR: GIOPBEN :OR: ADC1EN :OR: AFIOEN

ADC1_BASE	EQU	0x40012400
ADC1_SR		EQU ADC1_BASE+0x00	
ADC1_CR1	EQU ADC1_BASE+0x04	
ADC1_CR2	EQU ADC1_BASE+0x08	
ADC1_SMPR1 	EQU ADC1_BASE+0x0c 	
ADC1_SMPR2 	EQU ADC1_BASE+0x10 	
ADC1_SQR1	EQU ADC1_BASE+0x2c	
ADC1_SQR3	EQU ADC1_BASE+0x34	
ADC1_DR		EQU ADC1_BASE+0x4c	

CLEAR		EQU 0x01
RESETCUR	EQU	0x02
INMODE		EQU	0x06
DISPON		EQU	0x0c
DISPMODE	EQU 0x38
DEFSYM		EQU 0x40
CRLF		EQU	0xc0
WRTSYM		EQU	0x0200		
WRTDIGIT	EQU 0x0230		
WRTLETTER	EQU 0x0241			
WRTDOT		EQU	0x022e			
WRTSPACE	EQU	0x0220		

DIGREE1 	EQU 0X0210
DIGREE2 	EQU 0X0206
DIGREE3 	EQU 0X0209
DIGREE4 	EQU 0X0208
DIGREE5 	EQU 0X0208
DIGREE6 	EQU 0X0209
DIGREE7 	EQU 0X0206
DIGREE8 	EQU 0X0200
ROW 		EQU 0X58

;温度对应的电压值
ADC10	EQU	0x059A
ADC11	EQU	0x059E
ADC12	EQU	0x05AF
ADC13	EQU	0x05CA
ADC14	EQU	0x05EE
ADC15	EQU	0x0617
ADC16	EQU	0x0644
ADC17	EQU	0x0674
ADC18	EQU	0x06A7
ADC19	EQU	0x06DA
ADC20	EQU	0x070D
ADC21	EQU	0x0740
ADC22	EQU	0x0772
ADC23	EQU	0x07A3
ADC24	EQU	0x07D2
ADC25	EQU	0x0800
ADC26	EQU	0x082C
ADC27	EQU	0x0857
ADC28	EQU	0x0881
ADC29	EQU	0x08A9

STACK_TOP EQU 0X20002000
 AREA RESET,CODE,READONLY   ; AREA不能顶格写
 DCD STACK_TOP 				; MSP主堆栈指针
 DCD START   				; 复位，PC初始值 
 ENTRY         				; 指示开始执行,有了C文件，ENTRY注释掉
START                      	; 所有的标号必须顶格写，且无冒号

	BL RCC_CONFIG_72MHZ
	BL InitComp
	BL LedDefDegSym
	BL InitLED
 
	MOV	R0, #1
	LDR	R1, =ADC1_CR2
	STR	R0, [R1]
	LDR	R1, =ADC1_SR
WAIT_CONV
	LDR	R0, [R1]
	TST	R0, #0x2
	BEQ	WAIT_CONV
	
	LDR	R1, =ADC1_DR
	LDR	R0, [R1]
	
	LDR R1,=ADC10
	CMP R0,R1
	ITT LT
	MOVLT R0,#0
	BLT ShowLED1
	
	LDR R1,=ADC11
	CMP R0,R1
	ITT LT
	MOVLT R0,#1
	BLT ShowLED1
	
	LDR R1,=ADC12
	CMP R0,R1
	ITT LT
	MOVLT R0,#2
	BLT ShowLED1
	
	LDR R1,=ADC13
	CMP R0,R1
	ITT LT
	MOVLT R0,#3
	BLT ShowLED1
	
	LDR R1,=ADC14
	CMP R0,R1
	ITT LT
	MOVLT R0,#4
	BLT ShowLED1
	
	LDR R1,=ADC15
	CMP R0,R1
	ITT LT
	MOVLT R0,#5
	BLT ShowLED1
	
	LDR R1,=ADC16
	CMP R0,R1
	ITT LT
	MOVLT R0,#6
	BLT ShowLED1
	
	LDR R1,=ADC17
	CMP R0,R1
	ITT LT
	MOVLT R0,#7
	BLT ShowLED1
	
	LDR R1,=ADC18
	CMP R0,R1
	ITT LT
	MOVLT R0,#8
	BLT ShowLED1
	
	LDR R1,=ADC19
	CMP R0,R1
	ITT LT
	MOVLT R0,#9
	BLT ShowLED1
	
	LDR R1,=ADC20
	CMP R0,R1
	ITT LT
	MOVLT R0,#0
	BLT ShowLED2
	
	LDR R1,=ADC21
	CMP R0,R1
	ITT LT
	MOVLT R0,#1
	BLT ShowLED2
	
	LDR R1,=ADC22
	CMP R0,R1
	ITT LT
	MOVLT R0,#2
	BLT ShowLED2
	
	LDR R1,=ADC23
	CMP R0,R1
	ITT LT
	MOVLT R0,#3
	BLT ShowLED2
	
	LDR R1,=ADC24
	CMP R0,R1
	ITT LT
	MOVLT R0,#4
	BLT ShowLED2
	
	LDR R1,=ADC25
	CMP R0,R1
	ITT LT
	MOVLT R0,#5
	BLT ShowLED2
	
	LDR R1,=ADC26
	CMP R0,R1
	ITT LT
	MOVLT R0,#6
	BLT ShowLED2
	
	LDR R1,=ADC27
	CMP R0,R1
	ITT LT
	MOVLT R0,#7
	BLT ShowLED2
	
	LDR R1,=ADC28
	CMP R0,R1
	ITT LT
	MOVLT R0,#8
	BLT ShowLED2
	
	LDR R1,=ADC29
	CMP R0,R1
	ITT LT
	MOVLT R0,#9
	BLT ShowLED2
 
ShowLED1
	LDR R1, =GPIOA_ODR
	MOV R3, #WRTDIGIT
	
	ADD R2,R3,#1
	STR R2,[R1]
	BL ExcCmd
	B LEFT_DIG

ShowLED2
	LDR R1, =GPIOA_ODR
	MOV R3, #WRTDIGIT
	
	ADD R2,R3,#2
	STR R2,[R1]
	BL ExcCmd
	B LEFT_DIG

LEFT_DIG
	LDR R1, =GPIOA_ODR
	MOV R3,#WRTDIGIT
	
	ADD R2,R3,R0
	STR R2,[R1]
	BL ExcCmd
	
	MOV R2,#0x0203
	STR R2,[R1]
	BL ExcCmd
 	
	MOV	R2, #CRLF
	STR	R2, [R1]
	BL ExcCmd
	
LOOP
 B LOOP
 
LedDefDegSym
 	PUSH{R0,R1,R2,R3,LR}
	LDR R1,=GPIOA_ODR
	
	MOV R0,#ROW
	STR R0,[R1]
	BL ExcCmd
	
	MOV R2,#DIGREE1
	STR R2,[R1]
	BL ExcCmd
	
	ADD R0,R0,#1
	STR R0,[R1]
	BL ExcCmd
	
	MOV R2,#DIGREE2
	STR R2,[R1]
	BL ExcCmd
	
	ADD R0,R0,#1
	STR R0,[R1]
	BL ExcCmd
	
	MOV R2,#DIGREE3
	STR R2,[R1]
	BL ExcCmd
	
	ADD R0,R0,#1
	STR R0,[R1]
	BL ExcCmd
	
	MOV R2,#DIGREE4
	STR R2,[R1]
	BL ExcCmd
	
	ADD R0,R0,#1
	STR R0,[R1]
	BL ExcCmd
 	
	MOV R2,#DIGREE5
	STR R2,[R1]
	BL ExcCmd
	
	ADD R0,R0,#1
	STR R0,[R1]
	BL ExcCmd
	
	MOV R2,#DIGREE6
	STR R2,[R1]
	BL ExcCmd
	
	ADD R0,R0,#1
	STR R0,[R1]
	BL ExcCmd
	
	MOV R2,#DIGREE7
	STR R2,[R1]
	BL ExcCmd
	
	ADD R0,R0,#1
	STR R0,[R1]
	BL ExcCmd
	
	MOV R2,#DIGREE8
	STR R2,[R1]
	BL ExcCmd
	POP{R0,R1,R2,R3,PC}

InitLED
	PUSH	{R0, R1, LR}
	LDR	R1, =GPIOA_ODR
	
	MOV	R0, #DISPMODE
	STR	R0, [R1]
	BL ExcCmd
	
	MOV	R0, #DISPON
	STR	R0, [R1]
	BL ExcCmd
	
	MOV	R0, #INMODE
	STR	R0, [R1]
	BL ExcCmd
	
	MOV	R0, #CLEAR
	STR	R0, [R1]
	BL ExcCmd
	
	MOV	R0, #RESETCUR
	STR	R0, [R1]
	BL	ExcCmd
	
	POP	{R0, R1, PC}
 
ExcCmd
	PUSH	{R0, R1, LR}
	LDR	R1, =GPIOA_BSRR
	MOV	R0, #0x00000400
	STR	R0, [R1]
	MOV	R0, #0x04000000
	STR	R0, [R1]
	BL Delay
	POP	{R0, R1, PC}
 
Delay
	PUSH {R0,R1,R2,LR}
				
	MOVS R0,#0
	MOVS R1,#0
	MOVS R2,#0

DelayLoop0        
	ADDS R0,#1

	CMP R0,#33
	BCC DelayLoop0
	
	MOVS R0,#0
	ADDS R1,#1
	CMP R1,#33
	BCC DelayLoop0

	MOVS R0,#0
	MOVS R1,#0
	ADDS R2,#1
	CMP R2,#30
	BCC DelayLoop0
	
	POP {R0,R1,R2,PC}
  
InitComp
 PUSH {R0, R1, LR}
  
 ; 设置RCC的APB2使能寄存器，启动 GPIOA、GPIOB、AFIO、ADC1 部件
 LDR    R1, =RCC_APB2ENR     ; 0X4002101C
 LDR    R0, =APB2ENALL
 STR    R0, [R1]             ; 使能 GPIOA, GPIOB, AFIO, ADC1

 ; 设置 GPIOA 配置寄存器，令 PA0~PA10 设置为推挽输出(50MHz)
 MOV    R0, #CFGAL
 LDR    R1, =GPIOA_CRL
 STR    R0, [R1]
 LDR    R0, =CFGAH
 LDR    R1, =GPIOA_CRH
 STR    R0, [R1]
 
 ;设置GPIOB低配置寄存器：PB0 模拟输入
 MOV    R0, #CFGBL
 LDR    R1, =GPIOB_CRL
 STR    R0, [R1]
 
 ; 初始化 adc：默认独立模式、禁止扫描连续转换、软件开启转换右对齐、1个规则转换通道
 MOV	R0, #8
 LDR	R1, =ADC1_SQR3
 STR	R0, [R1]
 MOV	R0, #0x1
 LDR	R1, =ADC1_CR2
 STR	R0, [R1]

 POP {R0, R1, PC}
  
;;;;;;;;;;;;;;;;;;;;;;;;;;;;;;;;;;;;;;;;;
;;;RCC  时钟配置 HCLK=72MHz=HSE*9
;;;PCLK2=HCLK  PCLK1=HCLK/2
;;;;;;;;;;;;;;;;;;;;;;;;;;;;;;;;;;;;;;;;;
RCC_CONFIG_72MHZ
 LDR    R1,=0X40021000 ;RCC_CR
 LDR    R0,[R1]
 LDR    R2,=0X00010000 ;HSEON
 ORR    R0,R2
 STR    R0,[R1]
WAIT_HSE_RDY
 LDR    R2,=0X00020000 ;HSERDY
 LDR    R0,[R1]
 ANDS   R0,R2
 CMP    R0,#0
 BEQ    WAIT_HSE_RDY
 LDR    R1,=0X40022000 ;FLASH_ACR
 MOV    R0,#0X12
 STR    R0,[R1]
 LDR    R1,=0X40021004 ;RCC_CFGR时钟配置寄存器
 LDR    R0,[R1]
;PLL倍频系数,PCLK2,PCLK1分频设置
;HSE 9倍频PCLK2=HCLK,PCLK1=HCLK/2
;HCLK=72MHz 0x001D0400
;HCLK=64MHz 0x00190400
;HCLK=48MHz 0x00110400
;HCLK=32MHz 0x00090400
;HCLK=24MHz 0x00050400
;HCLK=16MHz 0x00010400
 LDR    R2,=0x001D0400 
 ORR    R0,R2
 STR    R0,[R1]
 LDR    R1,=0X40021000 ;RCC_CR
 LDR    R0,[R1]
 LDR    R2,=0X01000000	;PLLON
 ORR    R0,R2
 STR    R0,[R1]
WAIT_PLL_RDY
 LDR    R2,=0X02000000	;PLLRDY
 LDR    R0,[R1]
 ANDS   R0,R2
 CMP    R0,#0
 BEQ    WAIT_PLL_RDY
 LDR    R1,=0X40021004	;RCC_CFGR
 LDR    R0,[R1]
 MOV    R2,#0Xc002		; 配置 ADC 预分频器
 ORR    R0,R2
 STR    R0,[R1]
WAIT_HCLK_USEPLL
 LDR    R0,[R1]
 ANDS   R0,#0X08
 CMP    R0,#0X08
 BNE    WAIT_HCLK_USEPLL
 BX LR

END